## trunk/arch/arm/configs/wokoo_defconfig
```kconfig
CONFIG_SYSVIPC=y
CONFIG_NO_HZ=y
CONFIG_HIGH_RES_TIMERS=y
CONFIG_PREEMPT=y
CONFIG_CGROUPS=y
CONFIG_SYSFS_DEPRECATED=y
CONFIG_SYSFS_DEPRECATED_V2=y
CONFIG_BLK_DEV_INITRD=y
CONFIG_KALLSYMS_ALL=y
CONFIG_ARCH_WOKOO=y
CONFIG_VMSPLIT_1G=y
CONFIG_CMDLINE="root=/dev/ram rw console=ttyWK0,115200 init=/linuxrc"
CONFIG_CPU_FREQ=y
CONFIG_CPU_FREQ_STAT=y
CONFIG_CPU_FREQ_DEFAULT_GOV_ONDEMAND=y
CONFIG_CPUFREQ_DT=y
CONFIG_ARM_WOKOO_CPUFREQ=y
CONFIG_CPU_IDLE=y
CONFIG_ARM_CPUIDLE=y
CONFIG_VFP=y
#CONFIG_NEON=y
CONFIG_MODULES=y
CONFIG_MODULE_UNLOAD=y
CONFIG_GPIO_WOKOO=y
CONFIG_STMP_DEVICE=y
# CONFIG_BLK_DEV_BSG is not set
CONFIG_FB_CMDLINE=y
CONFIG_FB_NOTIFY=y
CONFIG_FB=y
CONFIG_FB_OPENCORES=y
CONFIG_FB_WOKOO=y
CONFIG_DUMMY_CONSOLE=y
CONFIG_FRAMEBUFFER_CONSOLE=y
CONFIG_FRAMEBUFFER_CONSOLE_DETECT_PRIMARY=y
CONFIG_FRAMEBUFFER_CONSOLE_ROTATION=y
CONFIG_FONT_SUPPORT=y
# CONFIG_FONTS is not set
CONFIG_FONT_8x8=y
CONFIG_FONT_8x16=y
CONFIG_LOGO=y
CONFIG_LOGO_LINUX_CLUT224=y

CONFIG_PARTITION_ADVANCED=y
CONFIG_BSD_DISKLABEL=y
CONFIG_DEVTMPFS=y
CONFIG_DEVTMPFS_MOUNT=y
CONFIG_BLK_DEV_LOOP=y
CONFIG_BLK_DEV_RAM=y
CONFIG_BLK_DEV_RAM_SIZE=8192
CONFIG_INPUT_EVDEV=y
CONFIG_KEYBOARD_GPIO=y
CONFIG_PINCTRL_WOKOO=y
CONFIG_PINCTRL_WOKOO_MUX=y
CONFIG_GPIO_SYSFS=y
# CONFIG_INPUT_MOUSE is not set
CONFIG_INPUT_MISC=y
CONFIG_SERIAL_WOKOO=y
CONFIG_SERIAL_WOKOO_DEBUG=y
CONFIG_SERIAL_WOKOO_CONSOLE=y
CONFIG_SERIAL_MCTRL_GPIO=y
CONFIG_SERIAL_DEV_BUS=y
CONFIG_HW_RANDOM=y
CONFIG_I2C_GPIO=y
CONFIG_I2C=y
CONFIG_SOC_IMX28=y
CONFIG_I2C_WOKOO=y
CONFIG_OV5648=y
CONFIG_VIDEO_SC031GSD=y
CONFIG_VIDEO_SC031GSM=y
CONFIG_GC0308WK=y
CONFIG_WATCHDOG=y
CONFIG_PWM_WOKOO=y
CONFIG_CRYPTO=y
CONFIG_CRYPTO_DEV_WOKOOCHIP=y
CONFIG_WOKOO_WDT=y
CONFIG_POWER_RESET=y
CONFIG_POWER_RESET_SYSCON_POWEROFF=y
CONFIG_POWER_SUPPLY=y

# CONFIG_MEDIA_SUBDRV_AUTOSELECT is not set
CONFIG_COMMON_CLK=y
CONFIG_HAS_DMA=y


CONFIG_MEDIA_CONTROLLER=y
CONFIG_VIDEO_V4L2=y
CONFIG_VIDEO_WOKOO_CSI=y
CONFIG_MEDIA_SUPPORT=y
CONFIG_MEDIA_CAMERA_SUPPORT=y
CONFIG_VIDEO_I2C=y



CONFIG_V4L_PLATFORM_DRIVERS=y
CONFIG_VIDEO_V4L2_SUBDEV_API=y

CONFIG_USB=y
CONFIG_USB_OTG=y
CONFIG_USB_DWC2=y
CONFIG_USB_DWC2_DUAL_ROLE=y
CONFIG_USB_GADGET=y
CONFIG_USB_CONFIGFS=y
CONFIG_USB_F_HID=y
CONFIG_USB_CONFIGFS_F_HID=y
CONFIG_RTC_CLASS=y
CONFIG_RTC_DRV_WOKOO=y
CONFIG_DMADEVICES=y
CONFIG_WOKOO_DMA=y
CONFIG_PWM=y
CONFIG_SPI=y
CONFIG_SPI_WOKOO_QSPI=y
CONFIG_SPI_WOKOO_SSI=y
CONFIG_MTD=y
CONFIG_MTD_BLKDEVS=y
CONFIG_MTD_BLOCK=y
CONFIG_MTD_CMDLINE_PARTS=y
CONFIG_MTD_SPI_NOR=y
# CONFIG_MTD_SPI_NOR_USE_4K_SECTORS is not set
CONFIG_MTD_UBI=y
CONFIG_EXT2_FS=y
CONFIG_EXT4_FS=y
CONFIG_VFAT_FS=y
CONFIG_JFFS2_FS=y
CONFIG_UBIFS_FS=y
CONFIG_TMPFS=y
CONFIG_TMPFS_POSIX_ACL=y
CONFIG_CRAMFS=y
CONFIG_ROMFS_FS=y
CONFIG_NLS_CODEPAGE_437=y
CONFIG_NLS_ASCII=y
CONFIG_NLS_ISO8859_1=y
CONFIG_NLS_UTF8=y
CONFIG_CRC_CCITT=y
CONFIG_DEBUG_INFO=y
CONFIG_MAGIC_SYSRQ=y
CONFIG_DEBUG_KERNEL=y
CONFIG_PRINTK_TIME=y
# CONFIG_DEBUG_PREEMPT is not set
CONFIG_DEBUG_RT_MUTEXES=y
CONFIG_DEBUG_SPINLOCK=y
CONFIG_DEBUG_MUTEXES=y
CONFIG_DEBUG_ATOMIC_SLEEP=y
CONFIG_DEBUG_USER=y
CONFIG_DEBUG_LL=y
CONFIG_EARLY_PRINTK=y
CONFIG_HAVE_ARM_ARCH_TIMER=y
CONFIG_RESET_CONTROLLER=y
CONFIG_SRAM=y
CONFIG_VIDEOBUF_GEN=y
CONFIG_VIDEOBUF_DMA_SG=y
CONFIG_VIDEOBUF_DMA_CONTIG=y
CONFIG_VIDEOBUF_VMALLOC=y
CONFIG_SOUND=y
CONFIG_SND=y
CONFIG_SND_SOC=y
CONFIG_SND_WOKOO_SOC=y
CONFIG_SND_WOKOO_PCM=y
CONFIG_SND_I2S_WOKOO_I2S=y
CONFIG_SND_SOC_ES8311=y
CONFIG_SND_SIMPLE_CARD=y
CONFIG_BACKLIGHT_CLASS_DEVICE=y
CONFIG_BACKLIGHT_WOKOO=y
CONFIG_OF=y
CONFIG_WOKOO_LCD=y

CONFIG_NET=y
CONFIG_PACKET=y
CONFIG_PACKET_DIAG=y
CONFIG_UNIX=y

CONFIG_INET=y
CONFIG_IP_MULTICAST=y
CONFIG_NEON=y
CONFIG_KERNEL_MODE_NEON=y






CONFIG_OF_NET=y
CONFIG_NETDEVICES=y
CONFIG_NET_CORE=y
CONFIG_USB_F_ACM=y
CONFIG_USB_U_SERIAL=y
CONFIG_USB_F_FS=y
CONFIG_USB_CONFIGFS_ACM=y

CONFIG_USB_CONFIGFS_F_FS=y
CONFIG_NETWORK_FILESYSTEMS=y
CONFIG_GENERIC_NET_UTILS=y
#CONFIG_ETHERNET  is not set
```

## trunk/arch/arm/configs/wokoo_large_storage_defconfig
```kconfig
CONFIG_SYSVIPC=y
CONFIG_NO_HZ=y
CONFIG_HIGH_RES_TIMERS=y
CONFIG_PREEMPT=y
CONFIG_CGROUPS=y
CONFIG_SYSFS_DEPRECATED=y
CONFIG_SYSFS_DEPRECATED_V2=y
CONFIG_BLK_DEV_INITRD=y
CONFIG_KALLSYMS_ALL=y
CONFIG_ARCH_WOKOO=y
CONFIG_VMSPLIT_1G=y
CONFIG_CMDLINE="root=/dev/ram rw console=ttyWK0,115200 init=/linuxrc"
CONFIG_CPU_FREQ=y
CONFIG_CPU_FREQ_STAT=y
CONFIG_CPU_FREQ_DEFAULT_GOV_ONDEMAND=y
CONFIG_CPUFREQ_DT=y
CONFIG_ARM_WOKOO_CPUFREQ=y
CONFIG_CPU_IDLE=y
CONFIG_ARM_CPUIDLE=y
CONFIG_VFP=y
#CONFIG_NEON=y
CONFIG_MODULES=y
CONFIG_MODULE_UNLOAD=y
CONFIG_GPIO_WOKOO=y
CONFIG_STMP_DEVICE=y
# CONFIG_BLK_DEV_BSG is not set
CONFIG_FB_CMDLINE=y
CONFIG_FB_NOTIFY=y
CONFIG_FB=y
CONFIG_FB_OPENCORES=y
CONFIG_FB_WOKOO=y
CONFIG_DUMMY_CONSOLE=y
CONFIG_FRAMEBUFFER_CONSOLE=y
CONFIG_FRAMEBUFFER_CONSOLE_DETECT_PRIMARY=y
CONFIG_FRAMEBUFFER_CONSOLE_ROTATION=y
CONFIG_FONT_SUPPORT=y
# CONFIG_FONTS is not set
CONFIG_FONT_8x8=y
CONFIG_FONT_8x16=y
CONFIG_LOGO=y
CONFIG_LOGO_LINUX_CLUT224=y
CONFIG_PARTITION_ADVANCED=y
CONFIG_BSD_DISKLABEL=y
CONFIG_DEVTMPFS=y
CONFIG_DEVTMPFS_MOUNT=y
CONFIG_BLK_DEV_LOOP=y
CONFIG_BLK_DEV_RAM=y
CONFIG_BLK_DEV_RAM_SIZE=8192
CONFIG_INPUT_EVDEV=y
CONFIG_KEYBOARD_GPIO=y
CONFIG_PINCTRL_WOKOO=y
CONFIG_PINCTRL_WOKOO_MUX=y
CONFIG_GPIO_SYSFS=y
# CONFIG_INPUT_MOUSE is not set
CONFIG_INPUT_MISC=y
CONFIG_SERIAL_WOKOO=y
CONFIG_SERIAL_WOKOO_DEBUG=y
CONFIG_SERIAL_WOKOO_CONSOLE=y
CONFIG_SERIAL_MCTRL_GPIO=y
CONFIG_SERIAL_DEV_BUS=y
CONFIG_HW_RANDOM=y
CONFIG_I2C_GPIO=y
CONFIG_I2C=y
CONFIG_SOC_IMX28=y
CONFIG_I2C_WOKOO=y
CONFIG_OV5648=y
CONFIG_VIDEO_SC031GSD=y
CONFIG_VIDEO_SC031GSM=y
CONFIG_WATCHDOG=y
CONFIG_PWM_WOKOO=y
CONFIG_CRYPTO=y
CONFIG_CRYPTO_DEV_WOKOOCHIP=y
CONFIG_WOKOO_WDT=y
CONFIG_POWER_RESET=y
CONFIG_POWER_RESET_SYSCON_POWEROFF=y
CONFIG_POWER_SUPPLY=y

# CONFIG_MEDIA_SUBDRV_AUTOSELECT is not set
CONFIG_COMMON_CLK=y
CONFIG_HAS_DMA=y


CONFIG_MEDIA_CONTROLLER=y
CONFIG_VIDEO_V4L2=y
CONFIG_VIDEO_WOKOO_CSI=y
CONFIG_MEDIA_SUPPORT=y
CONFIG_MEDIA_CAMERA_SUPPORT=y
CONFIG_VIDEO_I2C=y

CONFIG_USB_NET_RNDIS_HOST=y


CONFIG_V4L_PLATFORM_DRIVERS=y
CONFIG_VIDEO_V4L2_SUBDEV_API=y

CONFIG_USB=y
CONFIG_USB_OTG=y
CONFIG_USB_DWC2=y
CONFIG_USB_DWC2_DUAL_ROLE=y
CONFIG_USB_GADGET=y
CONFIG_USB_CONFIGFS=y
CONFIG_USB_F_HID=y
CONFIG_USB_CONFIGFS_F_HID=y
CONFIG_RTC_CLASS=y
CONFIG_RTC_DRV_WOKOO=y
CONFIG_DMADEVICES=y
CONFIG_WOKOO_DMA=y
CONFIG_PWM=y
CONFIG_SPI=y
CONFIG_SPI_WOKOO_QSPI=y
CONFIG_SPI_WOKOO_SSI=y
CONFIG_MTD=y
CONFIG_MTD_BLKDEVS=y
CONFIG_MTD_BLOCK=y
CONFIG_MTD_CMDLINE_PARTS=y
CONFIG_MTD_SPI_NOR=y
# CONFIG_MTD_SPI_NOR_USE_4K_SECTORS is not set
CONFIG_MTD_UBI=y
CONFIG_EXT2_FS=y
CONFIG_EXT4_FS=y
CONFIG_VFAT_FS=y
CONFIG_JFFS2_FS=y
CONFIG_UBIFS_FS=y
CONFIG_TMPFS=y
CONFIG_TMPFS_POSIX_ACL=y
CONFIG_CRAMFS=y
CONFIG_ROMFS_FS=y
CONFIG_NLS_CODEPAGE_437=y
CONFIG_NLS_ASCII=y
CONFIG_NLS_ISO8859_1=y
CONFIG_NLS_UTF8=y
CONFIG_CRC_CCITT=y
CONFIG_DEBUG_INFO=y
CONFIG_MAGIC_SYSRQ=y
CONFIG_DEBUG_KERNEL=y
CONFIG_PRINTK_TIME=y
# CONFIG_DEBUG_PREEMPT is not set
CONFIG_DEBUG_RT_MUTEXES=y
CONFIG_DEBUG_SPINLOCK=y
CONFIG_DEBUG_MUTEXES=y
CONFIG_DEBUG_ATOMIC_SLEEP=y
CONFIG_DEBUG_USER=y
CONFIG_DEBUG_LL=y
CONFIG_EARLY_PRINTK=y
CONFIG_HAVE_ARM_ARCH_TIMER=y
CONFIG_RESET_CONTROLLER=y
CONFIG_SRAM=y
CONFIG_VIDEOBUF_GEN=y
CONFIG_VIDEOBUF_DMA_SG=y
CONFIG_VIDEOBUF_DMA_CONTIG=y
CONFIG_VIDEOBUF_VMALLOC=y
CONFIG_SOUND=y
CONFIG_SND=y
CONFIG_SND_SOC=y
CONFIG_SND_WOKOO_SOC=y
CONFIG_SND_WOKOO_PCM=y
CONFIG_SND_I2S_WOKOO_I2S=y
CONFIG_SND_SOC_ES8311=y
CONFIG_SND_SIMPLE_CARD=y
CONFIG_BACKLIGHT_CLASS_DEVICE=y
CONFIG_BACKLIGHT_WOKOO=y
CONFIG_OF=y
CONFIG_WOKOO_LCD=y

CONFIG_NET=y
CONFIG_PACKET=y
CONFIG_PACKET_DIAG=y
CONFIG_UNIX=y

CONFIG_INET=y
CONFIG_IP_MULTICAST=y
CONFIG_NEON=y
CONFIG_KERNEL_MODE_NEON=y
CONFIG_OF_NET=y
CONFIG_NETDEVICES=y
CONFIG_NET_CORE=y
CONFIG_USB_F_ACM=y
CONFIG_USB_U_SERIAL=y
CONFIG_USB_F_FS=y
CONFIG_USB_CONFIGFS_F_FS=y
CONFIG_NETWORK_FILESYSTEMS=y
CONFIG_GENERIC_NET_UTILS=y
CONFIG_UNIX_SCM=y
CONFIG_IP_PNP=y
CONFIG_NET_IP_TUNNEL=y
CONFIG_INET_TUNNEL=y
CONFIG_INET_DIAG=y
CONFIG_INET_TCP_DIAG=y
CONFIG_IPV6=y
CONFIG_IPV6_SIT=y
#CONFIG_HAVE_NET_DSA=y

#CONFIG_NET_RX_BUSY_POLL=y

CONFIG_USB_NET_DRIVERS=y
CONFIG_USB_RTL8152=y
CONFIG_USB_USBNET=y
CONFIG_USB_NET_AX8817X=y
CONFIG_USB_NET_AX88179_178A=y
CONFIG_USB_NET_CDCETHER=y
CONFIG_USB_NET_SMSC95XX=y
CONFIG_USB_U_ETHER=y
CONFIG_USB_F_ECM=y
CONFIG_USB_F_SUBSET=y
CONFIG_USB_NET_CDC_NCM=y
#CONFIG_USB_NET_CDC_SUBSET_ENABLE=y
CONFIG_USB_NET_CDC_SUBSET=y
CONFIG_USB_F_RNDIS=y
CONFIG_USB_CONFIGFS_ACM=y
CONFIG_USB_CONFIGFS_ECM=y
CONFIG_USB_CONFIGFS_ECM_SUBSET=y
CONFIG_USB_CONFIGFS_RNDIS=y
CONFIG_USB_CONFIGFS_NCM=y
CONFIG_USB_ACM=y
CONFIG_XFRM_USER=y
CONFIG_INET_IPCOMP=y
CONFIG_INET_XFRM_TUNNEL=y
CONFIG_NET_INGRESS=y
CONFIG_SKB_EXTENSIONS=y
CONFIG_IP_ADVANCED_ROUTER=y
CONFIG_IP_FIB_TRIE_STATS=y
CONFIG_IP_MULTIPLE_TABLES=y
CONFIG_XFRM_INTERFACE=y
CONFIG_XFRM_SUB_POLICY=y
CONFIG_XFRM_MIGRATE=y
CONFIG_XFRM_STATISTICS=y
CONFIG_XFRM_IPCOMP=y
CONFIG_NET_KEY=y
CONFIG_NET_KEY_MIGRATE=y
CONFIG_XFRM=y
CONFIG_XFRM_OFFLOAD=y
CONFIG_XFRM_ALGO=y
CONFIG_IP_MROUTE_COMMON=y
CONFIG_IP_MROUTE=y
CONFIG_IP_MROUTE_MULTIPLE_TABLES=y

CONFIG_INET_AH=y
CONFIG_INET_ESP=y
CONFIG_INET_ESP_OFFLOAD=y
CONFIG_INET6_AH=y
CONFIG_INET6_ESP=y
CONFIG_INET6_ESP_OFFLOAD=y
CONFIG_INET6_IPCOMP=y
CONFIG_INET6_TUNNEL=y
CONFIG_IPV6_MULTIPLE_TABLES=y
CONFIG_IPV6_SUBTREES=y
CONFIG_IPV6_MROUTE=y
CONFIG_IPV6_MROUTE_MULTIPLE_TABLES=y
CONFIG_NETFILTER=y
CONFIG_NETFILTER_ADVANCED=y
CONFIG_NETFILTER_INGRESS=y
CONFIG_NETFILTER_NETLINK=y
CONFIG_NF_TABLES=y
CONFIG_NFT_XFRM=y
CONFIG_NETFILTER_XTABLES=y
CONFIG_NETFILTER_XT_MATCH_ECN=y
CONFIG_NETFILTER_XT_MATCH_HL=y
CONFIG_NF_REJECT_IPV4=y
CONFIG_IP_NF_IPTABLES=y
CONFIG_IP_NF_MATCH_AH=y
CONFIG_IP_NF_MATCH_ECN=y
CONFIG_IP_NF_MATCH_TTL=y
CONFIG_IP_NF_FILTER=y
CONFIG_IP_NF_TARGET_REJECT=y
CONFIG_IP6_NF_IPTABLES=y

CONFIG_NFS_FS=y
CONFIG_NFS_V2=y
CONFIG_NFS_V3=y
CONFIG_NFS_V3_ACL=y
CONFIG_NFS_V4=y
CONFIG_NFS_SWAP=y
CONFIG_NFS_V4_1=y
CONFIG_ROOT_NFS=y
CONFIG_SECURITY=y
CONFIG_SECURITY_NETWORK=y
CONFIG_SECURITY_NETWORK_XFRM=y
#CONFIG_USB_NET_NET1080 is not set
CONFIG_GC0308WK=y
#CONFIG_ETHERNET  is not set
CONFIG_TUN=y
```

## trunk/arch/arm/configs/wokoo_mini_defconfig
```kconfig
CONFIG_SYSVIPC=y
CONFIG_NO_HZ=y
CONFIG_HIGH_RES_TIMERS=y
CONFIG_PREEMPT=y
CONFIG_ARCH_WOKOO=y
CONFIG_VMSPLIT_1G=y
CONFIG_CMDLINE="root=/dev/ram rw console=ttyWK0,115200 init=/linuxrc"
CONFIG_CPU_FREQ=y
CONFIG_CPU_FREQ_STAT=y
CONFIG_CPU_FREQ_DEFAULT_GOV_ONDEMAND=y
CONFIG_CPUFREQ_DT=y
CONFIG_ARM_WOKOO_CPUFREQ=y
# CONFIG_ARM_BRCMSTB_AVS_CPUFREQ is not set
CONFIG_CPU_IDLE=y
CONFIG_ARM_CPUIDLE=y
# CONFIG_ARM_SCMI_POWER_DOMAIN is not set
# CONFIG_ARM_SCPI_POWER_DOMAIN is not set
# CONFIG_HW_RANDOM is not set
# CONFIG_SIRFSOC_WATCHDOG is not set
# CONFIG_MEDIA_USB_SUPPORT is not set
# CONFIG_SH_DMAE_BASE is not set
# CONFIG_TI_EDMA is not set
# CONFIG_DMA_OMAP is not set
# CONFIG_VIRTIO_MENU is not set
# CONFIG_NVMEM is not set
CONFIG_TMPFS=y
CONFIG_CONSOLE_LOGLEVEL_DEFAULT=4
# CONFIG_RUNTIME_TESTING_MENU is not set
# CONFIG_HWMON is not set
CONFIG_VFP=y
CONFIG_SLAB=y
CONFIG_MODULES=y
CONFIG_MODULE_UNLOAD=y
# CONFIG_BLK_DEV_BSG is not set
CONFIG_INPUT_EVDEV=y
CONFIG_KEYBOARD_GPIO=y
CONFIG_PINCTRL_WOKOO=y
CONFIG_PINCTRL_WOKOO_MUX=y
# CONFIG_INPUT_MOUSE is not set
CONFIG_INPUT_MISC=y
CONFIG_SERIAL_WOKOO=y
# CONFIG_LEGACY_PTYS is not set
# CONFIG_LDISC_AUTOLOAD is not set
CONFIG_SERIAL_WOKOO_CONSOLE=y
# CONFIG_MISC_RTSX_USB is not set
CONFIG_I2C=y
CONFIG_I2C_MXS=y
# CONFIG_I2C_DIOLAN_U2C is not set
# CONFIG_I2C_ROBOTFUZZ_OSIF is not set
# CONFIG_I2C_TINY_USB is not set
CONFIG_WATCHDOG=y
CONFIG_PWM_WOKOO=y
CONFIG_WOKOO_WDT=y
CONFIG_COMPILE_TEST=y
CONFIG_COMMON_CLK=y
CONFIG_HAS_DMA=y
CONFIG_VIDEO_V4L2_SUBDEV_API=y
CONFIG_VIDEO_V4L2=y
CONFIG_ARCH_CODEFAIR=y
CONFIG_VIDEO_WOKOO_CSI=y
CONFIG_MEDIA_SUPPORT=y
CONFIG_MEDIA_CAMERA_SUPPORT=y
CONFIG_MEDIA_CONTROLLER=y
CONFIG_VIDEO_I2C=y
CONFIG_USB_VIDEO_CLASS=m
CONFIG_V4L_PLATFORM_DRIVERS=y
CONFIG_VIDEO_MUX=y
CONFIG_SOC_CAMERA=y
CONFIG_V4L_MEM2MEM_DRIVERS=y
CONFIG_VIDEO_CODA=m
CONFIG_VIDEO_IMX_PXP=y
CONFIG_VIDEO_OV5648=y
CONFIG_VIDEO_GC0308=y
CONFIG_USB=y
CONFIG_USB_DWC2=y
CONFIG_USB_DWC2_DUAL_ROLE=y
CONFIG_USB_GADGET=y
CONFIG_USB_G_HID=y
CONFIG_USB_CONFIGFS_F_HID=y
# CONFIG_USB_MDC800 is not set
# CONFIG_USB_DUMMY_HCD is not set
CONFIG_DMADEVICES=y
CONFIG_WOKOO_DMA=y
CONFIG_PWM=y
CONFIG_SPI=y
CONFIG_SPI_WOKOO_QSPI=y
CONFIG_MTD=y
CONFIG_MTD_BLOCK=y
CONFIG_MTD_CMDLINE_PARTS=y
CONFIG_MTD_SPI_NOR=y
# CONFIG_MTD_SPI_NOR_USE_4K_SECTORS is not set
CONFIG_JFFS2_FS=y
CONFIG_CRAMFS=y
CONFIG_PRINTK_TIME=y
# CONFIG_DEBUG_PREEMPT is not set
CONFIG_RESET_CONTROLLER=y
CONFIG_SRAM=y
```

## trunk/arch/arm/mach-wokoo/Kconfig
```kconfig
# SPDX-License-Identifier: GPL-2.0
#
# Copyright (c) 2020 Codefair Semiconductor Technology Co., Ltd.
#		http://www.codefairsemi.com

# Configuration options for the WOKOO

config ARCH_WOKOO
	bool "code fair WOKOO"
	depends on ARCH_MULTI_V7
	select ARCH_HAS_HOLES_MEMORYMODEL
	select ARM_GIC
	select CLKSRC_WOKOO_PWM
	select COMMON_CLK_WOKOO
	select CLKSRC_WOKOO_APT
	select GPIOLIB
	select HAVE_WOKOO_I2C if I2C
	select HAVE_WOKOO_WATCHDOG if WATCHDOG
	select HAVE_WOKOO_RTC if RTC_CLASS
	select PINCTRL
	select PINCTRL_WOKOO
	help
	  CodeFair WOKOO series based systems

if ARCH_WOKOO

config CPU_WOKOO
	def_bool y
	select AP_DMAG if DMADEVICES
	help
	  Enable WOKOO CPU support

endif
```

## trunk/drivers/media/platform/codefair/wokoo/Kconfig
```kconfig
config VIDEO_WOKOO_CSI
	tristate "CodeFair WOKOO CMOS Sensor Interface Support"
	depends on VIDEO_V4L2 && COMMON_CLK && VIDEO_V4L2_SUBDEV_API && HAS_DMA
	depends on ARCH_WOKOO
	select VIDEOBUF2_DMA_CONTIG
	select V4L2_FWNODE
	help
	  This is a V4L2 driver for the CodeFair WOKOO CSI
	  To compile this driver as a module, choose M here: the module
	  will be called wokoo_csi.
```

## trunk/drivers/pinctrl/wokoo/Kconfig
```kconfig
# SPDX-License-Identifier: GPL-2.0-only
#
# Codefair WOKOO pinctrl drivers
#

config PINCTRL_WOKOO
	bool "WOKOO pins driver"
	depends on OF && (ARCH_WOKOO || COMPILE_TEST)
	select PINMUX
	select GENERIC_PINCONF
	default ARCH_WOKOO
	help
	  Say yes here to enable the Broadcom NS SoC pins driver.

	  The Codefair WOKOO pins driver supports muxing multi-purpose pins
	  that can be used for various functions (e.g. SPI, I2C, UART) as well
	  as GPIOs.

config PINCTRL_WOKOO_MUX
	bool "WOKOO pinmux driver"
	depends on OF
	depends on ARCH_WOKOO || COMPILE_TEST
	select PINMUX
	select GENERIC_PINCONF
	default ARCH_WOKOO
	help
	  Say yes here to enable the Codefair WOKOO MUX driver.

	  The Codefair WOKOO IOMUX driver supports group based IOMUX
	  configuration.
```

## trunk/sound/soc/codefair/Kconfig
```kconfig
# SPDX-License-Identifier: GPL-2.0-only

config SND_I2S_WOKOO_I2S
	tristate "wokoo I2S controller"
	depends on ARCH_WOKOO
	depends on COMMON_CLK
	select SND_SOC_GENERIC_DMAENGINE_PCM
	help
	  wokoo I2S
```
